## dts/bindings/behaviors/zmk,behavior-corne-pomodoro.yaml
```yaml
description: Control the Corne Pomodoro timer
compatible: "zmk,behavior-corne-pomodoro"
include: one_param.yaml
```

## dts/bindings/behaviors/zmk,behavior-corne-rgb-fx.yaml
```yaml
description: Select a Corne RGB effect or static palette color
compatible: "zmk,behavior-corne-rgb-fx"
include: one_param.yaml
```

## dts/bindings/behaviors/zmk,behavior-key-rgb.yaml
```yaml
description: Toggle the switch LED zone on connected halves
compatible: "zmk,behavior-key-rgb"
include: zero_param.yaml
```

## dts/bindings/led-strip/zmk,key-rgb-strip.yaml
```yaml
description: Corne underglow and switch LED mask
compatible: "zmk,key-rgb-strip"
include: base.yaml
properties:
  strip:
    type: phandle
    required: true
  chain-length:
    type: int
    required: true
    const: 27
```
